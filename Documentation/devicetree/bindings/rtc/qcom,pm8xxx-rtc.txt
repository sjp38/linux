## Documentation/devicetree/bindings/rtc/qcom,pm8xxx-rtc.txt
```
* Real-Time Clock for Qualcomm 8058/8921 PMICs

Required properties:
- compatible: should be one of the following.
    * "qcom,pm8058-rtc"
    * "qcom,pm8921-rtc"
- reg: base address of the register region
- interrupts: interrupt list for the RTC, must contain a single interrupt
              specifier for the alarm interrupt

Optional properties:
- allow-set-time: indicates that the setting of RTC time is allowed by
                  the host CPU

Example:

	rtc@11d {
		compatible = "qcom,pm8921-rtc";
		reg = <0x11d>;
		interrupts = <0x27 0>;
	};
```

## drivers/cpuidle/Kconfig.mips
```kconfig
#
# MIPS CPU Idle drivers
#

config MIPS_CPS_CPUIDLE
	bool "Support for MIPS Coherent Processing Systems"
	depends on SYS_SUPPORTS_MIPS_CPS && CPU_MIPSR2 && !MIPS_MT_SMTC
	select ARCH_NEEDS_CPU_IDLE_COUPLED if MIPS_MT
	select MIPS_CM
	help
	  Select this option to enable CPU idle driver for systems based
	  around the MIPS Coherent Processing System architecture - that
	  is, those with a Coherence Manager & optionally a Cluster
	  Power Controller.
```

## mm/damon/Kconfig
```kconfig
# SPDX-License-Identifier: GPL-2.0-only

menu "Data Access Monitoring"

config DAMON
	bool "DAMON: Data Access Monitoring Framework"
	help
	  This builds a framework that allows kernel subsystems to monitor
	  access frequency of each memory region. The information can be useful
	  for performance-centric DRAM level memory management.

	  See https://damonitor.github.io/doc/html/latest-damon/index.html for
	  more information.

config DAMON_KUNIT_TEST
	bool "Test for damon" if !KUNIT_ALL_TESTS
	depends on DAMON && KUNIT=y
	default KUNIT_ALL_TESTS
	help
	  This builds the DAMON Kunit test suite.

	  For more information on KUnit and unit tests in general, please refer
	  to the KUnit documentation.

	  If unsure, say N.

config DAMON_VADDR
	bool "Data access monitoring primitives for virtual address spaces"
	depends on DAMON && MMU
	select PAGE_EXTENSION if !64BIT
	select PAGE_IDLE_FLAG
	help
	  This builds the default data access monitoring primitives for DAMON
	  that works for virtual address spaces.

config DAMON_PADDR
	bool "Data access monitoring primitives for the physical address space"
	depends on DAMON && MMU
	select PAGE_EXTENSION if !64BIT
	select PAGE_IDLE_FLAG
	help
	  This builds the default data access monitoring primitives for DAMON
	  that works for physical address spaces.

config DAMON_PGIDLE
	bool "Data access monitoring primitives for page granularity idleness"
	depends on DAMON && MMU
	select PAGE_EXTENSION if !64BIT
	select PAGE_IDLE_FLAG
	help
	  This builds the default data access monitoring primitives for DAMON
	  that works for page granularity idleness monitoring.

config DAMON_VADDR_KUNIT_TEST
	bool "Test for DAMON primitives" if !KUNIT_ALL_TESTS
	depends on DAMON_VADDR && KUNIT=y
	default KUNIT_ALL_TESTS
	help
	  This builds the DAMON virtual addresses primitives Kunit test suite.

	  For more information on KUnit and unit tests in general, please refer
	  to the KUnit documentation.

	  If unsure, say N.

config DAMON_DBGFS
	bool "DAMON debugfs interface"
	depends on DAMON_VADDR && DAMON_PADDR && DEBUG_FS
	help
	  This builds the debugfs interface for DAMON.  The user space admins
	  can use the interface for arbitrary data access monitoring.

	  If unsure, say N.

config DAMON_DBGFS_KUNIT_TEST
	bool "Test for damon debugfs interface" if !KUNIT_ALL_TESTS
	depends on DAMON_DBGFS && KUNIT=y
	default KUNIT_ALL_TESTS
	help
	  This builds the DAMON debugfs interface Kunit test suite.

	  For more information on KUnit and unit tests in general, please refer
	  to the KUnit documentation.

	  If unsure, say N.

config DAMON_RECLAIM
	bool "Build DAMON-based reclaim (DAMON_RECLAIM)"
	depends on DAMON_PADDR
	help
	  This builds the DAMON-based reclamation subsystem.  It finds pages
	  that not accessed for a long time (cold) using DAMON and reclaim
	  those if enabled.

	  This is suggested to be used as a proactive and lightweight
	  reclamation under light memory pressure, while the traditional page
	  scanning-based reclamation is used for heavy pressure.

config DAMON_RECLAIM_ENABLE
	bool "Enable DAMON-based reclaim"
	depends on DAMON_RECLAIM
	help
	  Make DAMON_RECLAIM starts work after booting.  If this is not set,
	  user could enable it using its runtime interface.

config DAMON_RECLAIM_MIN_AGE
	int "Minimal microseconds of region to not accessed to be cold"
	depends on DAMON_RECLAIM
	default 5000000
	help
	  If a memory region has not accessed for this or longer time,
	  DAMON_RECLAIM identifies the region as cold and reclaim.
	  5 seconds by default.

config DAMON_RECLAIM_LIMIT_SZ
	int "Maximum bytes of memory to be reclaimed in each charging window"
	depends on DAMON_RECLAIM
	default 1073741824
	help
	  DAMON_RECLAIM charges amount of memory reclaimed within each charging
	  time window and limits no more than this limit is charged.  This
	  could be useful for limiting CPU usage of DAMON_RECLAIM.
	  1 GiB by default.

config DAMON_RECLAIM_LIMIT_MS
	int "The reclaimed memory charging window in milliseconds"
	depends on DAMON_RECLAIM
	default 1000
	help
	  The charge window for DAMON_RECLAIM_LIMIT_SZ.
	  1 second by default.

config DAMON_RECLAIM_WATERMARK_CHECK_INTERVAL
	int "DAMON_RECLAIM watermarks check time interval in microseconds"
	depends on DAMON_RECLAIM
	default 5000000
	help
	  Minimal time to wait before checking the watermarks, when
	  DAMON_RECLAIM is enabled but inactive due to its watermarks rule.
	  5 seconds by default.

config DAMON_RECLAIM_WATERMARK_HIGH
	int "Free memory rate (per thousand) for the high watermark"
	range 0 1000
	depends on DAMON_RECLAIM
	default 500
	help
	  If free memory of the system in bytes per thousand bytes is higher
	  than this, DAMON_RECLAIM becomes inactive, so it does nothing but
	  periodically checks the watermarks.  500 by default.

config DAMON_RECLAIM_WATERMARK_MID
	int "Free memory rate (per thousand) for the middle watermark"
	range 0 1000
	depends on DAMON_RECLAIM
	default 400
	help
	  If free memory of the system in bytes per thousand bytes is between
	  this and the low watermark, DAMON_RECLAIM becomes active, so starts
	  the work.
	  400 by default.

config DAMON_RECLAIM_WATERMARK_LOW
	int "Free memory rate (per thousand) for the low watermark"
	range 0 1000
	depends on DAMON_RECLAIM
	default 200
	help
	  If free memory of the system in bytes per thousand bytes is lower
	  than this, DAMON_RECLAIM becomes inactive, so does nothing but
	  periodically checks the watermarks.  So, in this case, we fall back
	  to the traditional page scanning-based reclamation logic.
	  200 by default.

config DAMON_RECLAIM_SAMPLING_INTERVAL
	int "Sampling interval for the monitoring in microseconds"
	depends on DAMON_RECLAIM
	default 5000
	help
	  The sampling interval of DAMON for the DAMON_RECLAIM.  Please refer
	  to the DAMON documentation for more detail.
	  5 ms by default.

config DAMON_RECLAIM_AGGREGATION_INTERVAL
	int "Aggregation interval for the monitoring in microseconds"
	depends on DAMON_RECLAIM
	default 100000
	help
	  The aggregation interval of DAMON for the DAMON_RECLAIM.  Please
	  refer to the DAMON documentation for more detail.
	  reclaim.  100 ms by default.

config DAMON_RECLAIM_MIN_NR_REGIONS
	int "Minimum number of monitoring regions"
	depends on DAMON_RECLAIM
	default 10
	help
	  The minimal number of monitoring regions for DAMON_RECLAIM.  Can be
	  used to set lower-bound of the monitoring's quality.  But setting
	  this too high could result in increased monitoring overhead.  Please
	  refer to the DAMON documentation for more detail.
	  10 by default.

config DAMON_RECLAIM_MAX_NR_REGIONS
	int "Maximum number of monitoring regions"
	depends on DAMON_RECLAIM
	default 1000
	help
	  The maximum number of monitoring regions for DAMON-based reclaim.
	  Can be used to set upper-bound of the monitoring overhead.  However,
	  setting this too low could result in bad monitoring quality.  Please
	  refer to the DAMON documentation for more detail.
	  1000 by default.

endmenu
```

## samples/damon/Kconfig
```kconfig
# SPDX-License-Identifier: GPL-2.0

menu "DAMON Samples"

config SAMPLE_DAMON_WSSE
	tristate "DAMON sameple module for working set size estimation"
	depends on DAMON && DAMON_VADDR
	help
	  This builds DAMON sample module for working set size estimation.

	  The module receives pid of a process, monitor access to the virtual
	  address space of the process, calculate the estimated working set
	  size of the process, and repeatedly print the size on the kernel log.

	  If unsure, say N.

config SAMPLE_DAMON_PRCL
	tristate "DAMON sameple module for access-aware proactive reclamation"
	depends on DAMON && DAMON_VADDR
	help
	  This builds DAMON sample module for access-aware proactive
	  reclamation.

	  The module receives pid of a process, monitor access to the virtual
	  address space of the process, find memory regions that not accessed,
	  and proactively reclaim the regions.

	  If unsure, say N.

endmenu
```
